## test/fixtures/bsp-custom/build/conf/bblayers.conf
```bitbake
LCONF_VERSION = "7"

BBPATH = "${TOPDIR}"
BSPDIR := "${@os.path.abspath(os.path.dirname(d.getVar('FILE', True)) + '/../..')}"

BBFILES ?= ""
BBLAYERS = " \
  ${BSPDIR}/sources/poky/meta \
  ${BSPDIR}/sources/poky/meta-poky \
  \
  ${BSPDIR}/sources/meta-acme-bsp \
"

# Absolute path from the author's machine: must be relocated on a fresh clone.
BBLAYERS += "/home/builder/bsp/sources/meta-openembedded/meta-oe"
BBLAYERS:append = " ${BSPDIR}/sources/meta-acme"
# Not checked out (diagnostic fixture).
BBLAYERS += "${BSPDIR}/sources/meta-qt6"
```

## test/fixtures/bsp-custom/sources/meta-acme-bsp/conf/layer.conf
```bitbake
BBPATH .= ":${LAYERDIR}"
BBFILES += "${LAYERDIR}/recipes-*/*/*.bb \
            ${LAYERDIR}/recipes-*/*/*.bbappend"
BBFILE_COLLECTIONS += "acme-bsp"
BBFILE_PATTERN_acme-bsp = "^${LAYERDIR}/"
BBFILE_PRIORITY_acme-bsp = "10"
LAYERDEPENDS_acme-bsp = "core"
LAYERSERIES_COMPAT_acme-bsp = "scarthgap"

# meta-raspberrypi idiom: one pattern per loaded collection.
BBFILES += "${@' '.join('${LAYERDIR}/dynamic-layers/%s/recipes*/*/*.bbappend' % layer \
               for layer in BBFILE_COLLECTIONS.split())}"
BBFILES += "${@' '.join('${LAYERDIR}/dynamic-layers/%s/recipes*/*/*.bb' % layer \
               for layer in BBFILE_COLLECTIONS.split())}"
```

## test/fixtures/bsp-custom/sources/meta-openembedded/meta-oe/conf/layer.conf
```bitbake
BBPATH .= ":${LAYERDIR}"
BBFILES += "${LAYERDIR}/recipes-*/*/*.bb ${LAYERDIR}/recipes-*/*/*.bbappend"
BBFILE_COLLECTIONS += "openembedded-layer"
BBFILE_PATTERN_openembedded-layer := "^${LAYERDIR}/"
BBFILE_PRIORITY_openembedded-layer = "6"
LAYERVERSION_openembedded-layer = "1"
LAYERDEPENDS_openembedded-layer = "core"
LAYERSERIES_COMPAT_openembedded-layer = "scarthgap"

BBFILES_DYNAMIC += " \
    acme:${LAYERDIR}/dynamic-layers/acme/*/*/*.bb \
    qt6-layer:${LAYERDIR}/dynamic-layers/qt6-layer/*/*/*.bb \
    !qt6-layer:${LAYERDIR}/dynamic-layers/no-qt6/*/*/*.bb \
"
```

## test/fixtures/bsp-custom/sources/poky/meta-poky/conf/layer.conf
```bitbake
BBPATH =. "${LAYERDIR}:"
BBFILE_COLLECTIONS += "yocto"
BBFILE_PATTERN_yocto = "^${LAYERDIR}/"
BBFILE_PRIORITY_yocto = "5"
LAYERDEPENDS_yocto = "core"
LAYERSERIES_COMPAT_yocto = "scarthgap"
```

## test/fixtures/bsp-custom/sources/poky/meta/conf/layer.conf
```bitbake
BBPATH .= ":${LAYERDIR}"
BBFILES += "${LAYERDIR}/recipes-*/*/*.bb"
BBFILE_COLLECTIONS += "core"
BBFILE_PATTERN_core = "^${LAYERDIR}/"
BBFILE_PRIORITY_core = "5"
LAYERSERIES_COMPAT_core = "scarthgap"
```

## test/fixtures/kas-project/meta-custom/conf/layer.conf
```bitbake
BBPATH .= ":${LAYERDIR}"
BBFILES += "${LAYERDIR}/recipes-*/*/*.bb"
BBFILE_COLLECTIONS += "custom"
BBFILE_PATTERN_custom = "^${LAYERDIR}/"
BBFILE_PRIORITY_custom = "8"
LAYERDEPENDS_custom = "core"
LAYERSERIES_COMPAT_custom = "scarthgap"
```

## test/fixtures/multi-build/meta-x/conf/layer.conf
```bitbake
BBFILE_COLLECTIONS += "x"
BBFILE_PRIORITY_x = "7"
LAYERSERIES_COMPAT_x = "scarthgap"
```

## test/fixtures/poky-mini/meta-poky/conf/layer.conf
```bitbake
BBPATH =. "${LAYERDIR}:"
BBFILES += "${LAYERDIR}/recipes-*/*/*.bb \
            ${LAYERDIR}/recipes-*/*/*.bbappend"
BBFILE_COLLECTIONS += "yocto"
BBFILE_PATTERN_yocto = "^${LAYERDIR}/"
BBFILE_PRIORITY_yocto = "5"
LAYERVERSION_yocto = "3"
LAYERDEPENDS_yocto = "core"
LAYERSERIES_COMPAT_yocto = "scarthgap"
```
